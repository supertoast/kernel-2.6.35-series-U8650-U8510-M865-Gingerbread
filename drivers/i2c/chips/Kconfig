## drivers/i2c/chips/Kconfig
```kconfig
#
# Miscellaneous I2C chip drivers configuration
#
# *** DEPRECATED! Do not add new entries! See Makefile ***
#

menu "Miscellaneous I2C Chip support"

config SENSORS_AKM8973
	tristate "AKM8973 Compass Driver"
	depends on I2C
	help
	 AKM8973 Compass Driver implemented by HTC.

config  UPDATE_COMPASS_FIRMWARE
        depends on HUAWEI_FEATURE_DEBUG
	default n
        bool "update akm8973 compass firmware"
        help
          Say Y here if you want to update akm8973 compass firmware 
config SENSORS_AKM8976
	tristate "AKM8976 Compass Driver"
	depends on I2C
	help
	 AKM8976 Compass Driver implemented by HTC.

config SENSORS_AKM8973
	tristate "AKM8973 Compass Driver"
	depends on I2C
	help
	 AKM8973 Compass Driver implemented by HTC.

config SENSORS_PCA963X
	tristate "Philips PCA963X 4-bit I2C-bus LED"
	depends on I2C && EXPERIMENTAL
	help
	 If you say yes here you get support for the Philips PCA963X
	 4-bit I2C-bus LED.

	 This driver can also be built as a module.  If so, the module
	 will be called pca963X.

config SENSORS_MT9T013
	tristate "MT9T013 Camera Driver"
	depends on I2C
	default n
	help
	 MT9T013 Camera Driver implemented by HTC.

config HUAWEI_FEATURE_QWERTY_KEYPAD_ADP5587
	tristate "Qwerty Keypad Controller Driver"
	depends on HUAWEI_KERNEL
	default n
	help
	 Driver for Qwerty Keypad Controller Driver.
#/* < DTS7X27K00120101103   M——mem；001；20101103 begin */
config HUAWEI_FEATURE_SENSORS_ST_LSM303DLH
	tristate "LSM303DLH is a 6D sensors(gs&ms)"
	depends on HUAWEI_KERNEL
	default n
	help
	 The LSM303DLH is a system-in-package featuring a 3D
	 digital linear acceleration sensor and a 3D digital magnetic sensor.
#/* DTS7X27K00120101103   M——mem；001；20101103 end > */
config HUAWEI_FEATURE_SENSORS_AK8975
	tristate "AK8975"
	depends on HUAWEI_KERNEL
	default n
	help
	  If you say yes here you get support for Asahi Kasei's 
	  orientation sensor AK8975.
endmenu
```

## drivers/nfc/Kconfig
```kconfig
#
# Near Field Communication (NFC) devices
#

config HUAWEI_NFC_PN544
	default n
	bool "HUAWEI NFC PN544"
	help
		Say yes if you want PN544 Near Field Communication driver.
		This is for i2c connected version. If unsure, say N here.
```
